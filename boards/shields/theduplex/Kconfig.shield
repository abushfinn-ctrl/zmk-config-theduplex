## boards/shields/theduplex/Kconfig.shield
```kconfig
config SHIELD_THEDUPLEX_LEFT
    def_bool $(shields_list_contains,theduplex_left)
  
config SHIELD_THEDUPLEX_RIGHT
    def_bool $(shields_list_contains,theduplex_right)
  
```

## config/west.yml
```yaml
manifest:
  remotes:
    - name: zmkfirmware
      url-base: https://github.com/zmkfirmware
    - name: zmk-rgbled-widget
      url-base: https://github.com/caksoylar/zmk-rgbled-widget
  projects:
    - name: zmk
      remote: zmkfirmware
      revision: v0.3 
      import: app/west.yml
    - name: zmk-rgbled-widget  # <-- new entry
      url: https://github.com/caksoylar/zmk-rgbled-widget
      revision: v0.3   
  self:
    path: config
```
